
#include "FS.h"
#include "SD.h"
#include "SPI.h"
#include <WiFi.h>
#include <HTTPClient.h>
#include <WiFiManager.h> 
#include <time.h>
#include <sys/time.h>

// --- USER CONFIGURATION: Default Office WiFi ---
const char* OFFICE_WIFI_SSID = "Anantkaal_4G";
const char* OFFICE_WIFI_PASS = "Setupdev@123";

// Hardware Pins for external MCU UART connection
const int MCU_RX_PIN = 16;      // Connect to external MCU TX pin
const int MCU_TX_PIN = 17;      // Connect to external MCU RX pin (Optional)
const int JST_SWITCH_PIN = 5;   // Hardware JST wire switch
const int SD_CS_PIN = 27;       // Safe Non-Strapping Chip Select Pin

// Default starting baud rate for the external MCU
long currentMcuBaudRate = 115200; 

// Dynamic file tracking structures
String currentLogPath = "";
File logFile;
bool isNewLine = true; // Timestamp tracking flag

// Global buffer to hold custom API URL from WiFiManager
char custom_api_url[128] = "http://your-api-endpoint.com/upload";

// FreeRTOS Multi-Core Synchronization Structures
SemaphoreHandle_t spiMutex;       
volatile bool uploadReadyFlag = false; 
String fileToUpload = "";         

// Forward declarations
void openNextSequentialFile();
void triggerBackgroundUpload();
void wifiUploadTaskProcessor(void * parameter);
void uploadLogToAPI(const char* url, String filePath);
bool isValidBaudRate(long baud);

void setup() {
  // Initialize PC Serial Monitor for command input and debugging
  Serial.begin(115200);
  while (!Serial) {
    ; 
  }
  
  Serial.println("\n==================================================");
  Serial.println("--- ESP32 Dual-Core SPI UART Serial Logger ---");
  Serial.println("==================================================");
  Serial.println(">> MONITOR INTERFACE COMMANDS:");
  Serial.println("   - Type 'wifi' or short GPIO 5 to launch portal & upload logs.");
  Serial.println("   - Type 'reset' to wipe old logs and restart sequence.");
  Serial.println("   - Type a specific valid baud rate to reconfigure target UART.");
  Serial.println("==================================================");

  pinMode(MCU_RX_PIN, INPUT_PULLUP);
  spiMutex = xSemaphoreCreateMutex();

  Serial2.begin(currentMcuBaudRate, SERIAL_8N1, MCU_RX_PIN, MCU_TX_PIN);
  Serial.print("UART Port 2 initialized at: ");
  Serial.print(currentMcuBaudRate);
  Serial.println(" baud.");

  pinMode(JST_SWITCH_PIN, INPUT_PULLUP);

  SPI.begin(18, 19, 23, SD_CS_PIN); 

  xSemaphoreTake(spiMutex, portMAX_DELAY);
  Serial.print("Initializing HW-125 SD Card via Native VSPI... ");
  if (!SD.begin(SD_CS_PIN, SPI, 4000000)) {
    Serial.println("FAILED! Verify VCC is on 5V and card is formatted to FAT32.");
    while (true); 
  }
  Serial.println("SUCCESS.");
  xSemaphoreGive(spiMutex);

  openNextSequentialFile();

  // Spawn the background WiFi network processor on Core 0
  xTaskCreatePinnedToCore(
    wifiUploadTaskProcessor,  
    "WiFiUploadTask",         
    8192,                     
    NULL,                     
    1,                        
    NULL,                     
    0                         
  );
}

void loop() {
  // 1. DATA LOGGING STREAM (Always Running Uninterrupted on Core 1):
  if (Serial2.available() > 0) {
    while (Serial2.available() > 0) {
      char inByte = Serial2.read();
      
      // Filter out pure garbage bytes generated by wire bounces or floating lines
      if (inByte == (char)0xFF || inByte == '\0') {
        continue; 
      }

      // --- TIMESTAMP INJECTION LOGIC ---
      if (isNewLine && inByte != '\n' && inByte != '\r') {
        struct timeval tv;
        gettimeofday(&tv, NULL);
        char timeStamp[40];

        // If system time has successfully synced with NTP (Unix Epoch > 1B)
        if (tv.tv_sec > 1000000000) {
          struct tm * timeinfo = localtime(&tv.tv_sec);
          sprintf(timeStamp, "[%04d-%02d-%02d %02d:%02d:%02d.%03d] ",
                  timeinfo->tm_year + 1900, timeinfo->tm_mon + 1, timeinfo->tm_mday,
                  timeinfo->tm_hour, timeinfo->tm_min, timeinfo->tm_sec, (int)(tv.tv_usec / 1000));
        } else {
          // Fallback to Session Boot Milliseconds until network syncs
          unsigned long runMillis = millis();
          unsigned long ms = runMillis % 1000;
          unsigned long secs = (runMillis / 1000) % 60;
          unsigned long mins = (runMillis / 60000) % 60;
          unsigned long hrs  = (runMillis / 3600000);
          sprintf(timeStamp, "[%02lu:%02lu:%02lu.%03lu] ", hrs, mins, secs, ms);
        }

        Serial.print(timeStamp); 
        if (logFile) {
          xSemaphoreTake(spiMutex, portMAX_DELAY);
          logFile.print(timeStamp); 
          xSemaphoreGive(spiMutex);
        }
        isNewLine = false; 
      }
      // ---------------------------------

      Serial.print(inByte);         
      
      if (logFile) {
        xSemaphoreTake(spiMutex, portMAX_DELAY);
        logFile.print(inByte);      
        xSemaphoreGive(spiMutex);
      }

      // Trigger flag to attach timestamp to the start of the next line
      if (inByte == '\n') {
        isNewLine = true;
      }
    }
    
    if (logFile) {
      xSemaphoreTake(spiMutex, portMAX_DELAY);
      logFile.flush();              
      xSemaphoreGive(spiMutex);
    }
  }

  // 2. SOFTWARE COMMAND MONITOR
  if (Serial.available() > 0) {
    String commandInput = Serial.readStringUntil('\n');
    commandInput.trim(); 

    if (commandInput.length() > 0) {
      if (commandInput.equalsIgnoreCase("wifi")) {
        triggerBackgroundUpload();
      } 
      else if (commandInput.equalsIgnoreCase("reset")) {
        Serial.println("\n--------------------------------------------------");
        Serial.println("[Reset Command] Wiping sequential files. Restarting at log_file1...");
        
        xSemaphoreTake(spiMutex, portMAX_DELAY);
        if (logFile) {
          logFile.close();
        }

        int fileIndex = 1;
        while (true) {
          String deleteFilepath = "/log_file" + String(fileIndex) + ".txt";
          if (SD.exists(deleteFilepath)) {
            SD.remove(deleteFilepath);
            fileIndex++;
          } else {
            break;
          }
        }
        xSemaphoreGive(spiMutex);

        openNextSequentialFile();
        Serial.println("--------------------------------------------------");
      }
      else {
        long targetBaud = commandInput.toInt();
        
        if (isValidBaudRate(targetBaud)) {
          Serial.println("\n--------------------------------------------------");
          Serial.print("[Baud Change Request Accepted] Switching to: ");
          Serial.print(targetBaud);
          Serial.println(" baud.");
          
          xSemaphoreTake(spiMutex, portMAX_DELAY);
          if (logFile) {
            logFile.println("\n--- Session Closed Due to Baud Rate Reconfiguration ---");
            logFile.close();
          }
          xSemaphoreGive(spiMutex);

          currentMcuBaudRate = targetBaud;
          Serial2.end();
          pinMode(MCU_RX_PIN, INPUT_PULLUP);
          Serial2.begin(currentMcuBaudRate, SERIAL_8N1, MCU_RX_PIN, MCU_TX_PIN);
          
          openNextSequentialFile();
          Serial.println("--------------------------------------------------");
        } 
        else {
          Serial.println("Invalid Baud rate");
        }
      }
    }
  }

  // 3. HARDWARE TRIGGER MONITOR
  if (digitalRead(JST_SWITCH_PIN) == LOW && !uploadReadyFlag) {
    delay(200); 
    if (digitalRead(JST_SWITCH_PIN) == LOW) {
      triggerBackgroundUpload();
      
      while (digitalRead(JST_SWITCH_PIN) == LOW) {
        delay(10);
      }
    }
  }
}

// Atomic file rotation prior to network launch
void triggerBackgroundUpload() {
  if (uploadReadyFlag) {
    Serial.println("[System Warning] Background network transmission loop is already active!");
    return;
  }

  xSemaphoreTake(spiMutex, portMAX_DELAY);
  if (logFile) {
    logFile.close();
  }
  fileToUpload = currentLogPath; 
  xSemaphoreGive(spiMutex);

  openNextSequentialFile();
  uploadReadyFlag = true;
}

// Background Network Processing Core Task running independently on Core 0
void wifiUploadTaskProcessor(void * parameter) {
  unsigned long defaultWifiStart = millis();
  bool tryingDefault = true;
  bool ntpRequested = false;

  // Initiate background connection to Default Office WiFi on boot
  WiFi.mode(WIFI_STA);
  WiFi.begin(OFFICE_WIFI_SSID, OFFICE_WIFI_PASS);

  while (true) {
    
    // --- STATE 1: User Override triggered (Discards default attempts) ---
    if (uploadReadyFlag) {
      tryingDefault = false;
      WiFi.disconnect(true, true); // Instantly drop any existing connection attempts
      vTaskDelay(pdMS_TO_TICKS(200));

      Serial.println("\n==================================================");
      Serial.println("[Core 0] Launching Background WiFi Setup Portal...");
      Serial.println("==================================================");

      WiFiManager wm;
      WiFiManagerParameter custom_api_setting("api_url", "Target API Destination", custom_api_url, 128);
      wm.addParameter(&custom_api_setting);

      Serial.println("Connect your phone/PC to the WiFi network: 'ESP32_Data_Logger'");
      
      if (!wm.startConfigPortal("ESP32_Data_Logger")) {
        Serial.println("[Core 0] Portal failed to establish link or timed out.");
      } else {
        Serial.println("[Core 0] Connected to WiFi Network successfully.");
        strncpy(custom_api_url, custom_api_setting.getValue(), sizeof(custom_api_url) - 1);
        Serial.print("[Core 0] Target URL endpoint saved as: ");
        Serial.println(custom_api_url);

        uploadLogToAPI(custom_api_url, fileToUpload);
      }

      WiFi.disconnect(true, true);
      WiFi.mode(WIFI_OFF);
      Serial.println("\n[Core 0] Background transaction completed. WiFi shut down.");
      uploadReadyFlag = false; 
    }
    
    // --- STATE 2: Background NTP Sync Handling (Using millis) ---
    if (tryingDefault) {
      // Condition A: 60 Second timeout reached
      if (millis() - defaultWifiStart > 60000) {
        Serial.println("\n[Core 0] Default WiFi timeout (60s). Disconnecting to preserve resources.");
        WiFi.disconnect(true, true);
        WiFi.mode(WIFI_OFF);
        tryingDefault = false;
      }
      // Condition B: Connected to Default WiFi, ask for Time
      else if (WiFi.status() == WL_CONNECTED && !ntpRequested) {
        Serial.println("\n[Core 0] Connected to Office WiFi. Requesting NTP Time...");
        // Indian Standard Time is UTC+5:30 (19800 seconds)
        configTime(19800, 0, "pool.ntp.org", "time.nist.gov"); 
        ntpRequested = true;
      }
      // Condition C: Waiting for NTP Server to confirm sync
      else if (ntpRequested) {
        struct timeval tv;
        gettimeofday(&tv, NULL);
        if (tv.tv_sec > 1000000000) { 
          Serial.println("\n[Core 0] High-Precision RTC Time Synced! Shutting off Default WiFi.");
          WiFi.disconnect(true, true);
          WiFi.mode(WIFI_OFF);
          tryingDefault = false; 
        }
      }
    }

    // Essential FreeRTOS low-overhead yield (prevents Core 0 Watchdog crashes)
    vTaskDelay(pdMS_TO_TICKS(50)); 
  }
}

// Interleaved streaming chunk uploader running exclusively on Core 0
void uploadLogToAPI(const char* url, String filePath) {
  if (WiFi.status() != WL_CONNECTED) {
    Serial.println("[Core 0] Upload failed: Connection dropped.");
    return;
  }

  xSemaphoreTake(spiMutex, portMAX_DELAY);
  File uploadFile = SD.open(filePath, FILE_READ);
  xSemaphoreGive(spiMutex);

  if (!uploadFile) {
    Serial.println("[Core 0] Upload error: Unable to read file target location: " + filePath);
    return;
  }

  size_t fileSize = uploadFile.size();
  if (fileSize == 0) {
    Serial.println("[Core 0] Dataset target is empty. Aborting post.");
    xSemaphoreTake(spiMutex, portMAX_DELAY);
    uploadFile.close();
    xSemaphoreGive(spiMutex);
    return;
  }

  String urlStr = String(url);
  urlStr.replace("http://", "");
  urlStr.replace("https://", "");
  int slashIdx = urlStr.indexOf("/");
  String hostPort = (slashIdx == -1) ? urlStr : urlStr.substring(0, slashIdx);
  String uri = (slashIdx == -1) ? "/" : urlStr.substring(slashIdx);
  int colonIdx = hostPort.indexOf(":");
  String host = (colonIdx == -1) ? hostPort : hostPort.substring(0, colonIdx);
  int port = (colonIdx == -1) ? 80 : hostPort.substring(colonIdx + 1).toInt();

  Serial.println("[Core 0] Connecting to stream target destination -> " + host + ":" + String(port));
  WiFiClient client;
  if (!client.connect(host.c_str(), port)) {
    Serial.println("[Core 0] Connection to destination server failed.");
    xSemaphoreTake(spiMutex, portMAX_DELAY);
    uploadFile.close();
    xSemaphoreGive(spiMutex);
    return;
  }

  client.print("POST " + uri + " HTTP/1.1\r\n");
  client.print("Host: " + host + "\r\n");
  client.print("Content-Type: text/plain\r\n");
  client.print("Content-Length: " + String(fileSize) + "\r\n");
  client.print("Connection: close\r\n\r\n");

  Serial.println("[Core 0] Streaming log data simultaneously while logging continues on Core 1...");
  uint8_t chunkBuffer[512];
  size_t remainingBytes = fileSize;

  while (remainingBytes > 0 && client.connected()) {
    size_t bytesToRead = min(remainingBytes, sizeof(chunkBuffer));
    
    xSemaphoreTake(spiMutex, portMAX_DELAY);
    uploadFile.read(chunkBuffer, bytesToRead);
    xSemaphoreGive(spiMutex);
    
    client.write(chunkBuffer, bytesToRead);
    remainingBytes -= bytesToRead;
    
    vTaskDelay(pdMS_TO_TICKS(5)); 
  }

  unsigned long timeoutAnchor = millis();
  while (client.connected() && millis() - timeoutAnchor < 3000) {
    if (client.available()) {
      String serverLine = client.readStringUntil('\n');
      if (serverLine.startsWith("HTTP/1.1")) {
        Serial.println("  -> Server Status Code Response: " + serverLine);
      }
    }
    vTaskDelay(pdMS_TO_TICKS(1));
  }

  client.stop();
  
  xSemaphoreTake(spiMutex, portMAX_DELAY);
  uploadFile.close();
  xSemaphoreGive(spiMutex);
  Serial.println("[Core 0] File background upload completed cleanly.");
}

// Function handling the creation of unique structural sequential file indexes
void openNextSequentialFile() {
  int fileIndex = 1;
  xSemaphoreTake(spiMutex, portMAX_DELAY);
  while (true) {
    String testFilepath = "/log_file" + String(fileIndex) + ".txt";
    if (!SD.exists(testFilepath)) {
      currentLogPath = testFilepath;
      break;
    }
    fileIndex++; 
  }

  logFile = SD.open(currentLogPath, FILE_APPEND);
  if (!logFile) {
    Serial.println("Critical Error: Failed to generate file pointer for " + currentLogPath);
  } else {
    Serial.println(">> Active File Session: Routing logs directly to " + currentLogPath);
    logFile.print("\n--- Session Opened. Watching UART at ");
    logFile.print(currentMcuBaudRate);
    logFile.println(" Baud ---");
    logFile.flush();
  }
  xSemaphoreGive(spiMutex);
}

// Validation check using standard hardware microcontroller serial frequencies
bool isValidBaudRate(long baud) {
  const long validRates[] = {300, 1200, 2400, 4800, 9600, 14400, 19200, 28800, 38400, 57600, 115200, 230400, 460800, 921600};
  const int numRates = sizeof(validRates) / sizeof(validRates[0]);
  
  for (int i = 0; i < numRates; i++) {
    if (baud == validRates[i]) {
      return true;
    }
  }
  return false;
}